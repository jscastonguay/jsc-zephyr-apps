## CMakeLists.txt
```
cmake_minimum_required(VERSION 3.20.0)

find_package(Zephyr REQUIRED HINTS $ENV{ZEPHYR_BASE})

project(test01)

target_sources(app PRIVATE src/main.c)
```

## prj.conf
```kconfig
# Encore rien à ajouter.
```

## src/main.c
```c
#include <stdio.h>
#include <stdbool.h>

unsigned int i = 0;

int main()
{
    while (true)
    {
        // Je dervais utiliser pinrtk, qui est minimal et threadsafe.
        printf("Hello, World: %d\n", i);
        i++;
    }
    return 0;
}
```
