## 04_button_demo_avec_led/boards/nucleo_h753zi.conf
```kconfig
CONFIG_GPIO=y
CONFIG_GPIO_INIT_PRIORITY=40

# CONFIG_GPIO_GET_DIRECTION is not set
# CONFIG_GPIO_GET_CONFIG is not set
#CONFIG_GPIO_HOGS is not set
# CONFIG_GPIO_ENABLE_DISABLE_INTERRUPT is not set
CONFIG_GPIO_STM32=y
```

## modules/button/drivers/button/Kconfig
```kconfig
config CUSTOM_BUTTON
    bool "Custom button driver"
    default n        # Le désactiver par défaut
    depends on GPIO  # Le rendre dépendant de GPIO
    help
      Active le driver pour les boutons personnalisés.

config BUTTON_INIT_PRIORITY
    int "Custom button initialization priority"
    default 90
    depends on CUSTOM_BUTTON
```

## modules/say_hello/Kconfig
```kconfig
# Creation d'un symbole pour menuconfig
config SAY_HELLO
    bool "Active say_hello module pour une sortie basique via le terminal"
    default n
    depends on PRINTK
    help
        Cette option active le module say_hello, qui fournit une fonction simple pour afficher
        "Hello, World!" via le terminal.
        
```

## test01/build/Kconfig/arch/Kconfig
```kconfig
# Load Zephyr Arch Kconfig descriptions.
osource "/home/jsc/zephyrproject/zephyr/arch/rx/Kconfig"
osource "/home/jsc/zephyrproject/zephyr/arch/x86/Kconfig"
osource "/home/jsc/zephyrproject/zephyr/arch/xtensa/Kconfig"
osource "/home/jsc/zephyrproject/zephyr/arch/sparc/Kconfig"
osource "/home/jsc/zephyrproject/zephyr/arch/riscv/Kconfig"
osource "/home/jsc/zephyrproject/zephyr/arch/posix/Kconfig"
osource "/home/jsc/zephyrproject/zephyr/arch/openrisc/Kconfig"
osource "/home/jsc/zephyrproject/zephyr/arch/mips/Kconfig"
osource "/home/jsc/zephyrproject/zephyr/arch/arm64/Kconfig"
osource "/home/jsc/zephyrproject/zephyr/arch/arm/Kconfig"
osource "/home/jsc/zephyrproject/zephyr/arch/arc/Kconfig"
```

## test01/build/Kconfig/boards/Kconfig.defconfig
```kconfig
# Load Zephyr board defconfig descriptions.
osource "/home/jsc/zephyrproject/zephyr/boards/st/nucleo_h753zi/Kconfig.defconfig"
```

## test01/build/Kconfig/boards/Kconfig.sysbuild
```kconfig
# Load Sysbuild board Kconfig descriptions.
osource "/home/jsc/zephyrproject/zephyr/boards/st/nucleo_h753zi/Kconfig.sysbuild"
```
