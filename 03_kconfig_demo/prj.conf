## CMakeLists.txt
```
cmake_minimum_required(VERSION 3.20.0)

set(ZEPHYR_EXTRA_MODULES ${ZEPHYR_EXTRAMODULES} ${CMAKE_SOURCE_DIR}/../modules/say_hello)

find_package(Zephyr REQUIRED HINTS $ENV{ZEPHYR_BASE})
project(ramdom)

target_sources(app PRIVATE src/main.c)
```

## prj.conf
```kconfig
# Fichier nécessaire, même si vide et même si un autre fichier de configuration
# (exemple nucleo_h753zi.conf) est utilisé.
```

## boards/nucleo_h753zi.conf
```kconfig
# Pour la génération random
CONFIG_STACK_POINTER_RANDOM=0
CONFIG_TEST_RANDOM_GENERATOR=y
CONFIG_TIMER_RANDOM_GENERATOR=y
CONFIG_TEST_CSPRNG_GENERATOR=y

# Pour mon module say_hello
CONFIG_SAY_HELLO=y

# Pour aqctiver le support du FPU et des fonctions flottantes
CONFIG_FPU=y
CONFIG_FP_HARDABI=y
CONFIG_FPU_SHARING=y

# Pour activer les fonctions flottantes dans picolibc
CONFIG_PICOLIBC_IO_FLOAT=y
# CONFIG_PICOLIBC_IO_LONG_LONG is not set
```

## src/main.c
```c
#include <zephyr/random/random.h>

#ifdef CONFIG_SAY_HELLO
#include "say_hello.h"
#endif

static const uint32_t sleepTime_ms = 1000;

int main(void)
{
    uint32_t randomValue;
    double randomFloat;

    while (1) {
        randomValue = sys_rand32_get();
        randomFloat = ((double)randomValue) / UINT32_MAX;
        printk("Random Value: %f\n", randomFloat);

#ifdef CONFIG_SAY_HELLO
        say_hello();
#endif

        k_msleep(sleepTime_ms);
    }

    return 0;
}
```
